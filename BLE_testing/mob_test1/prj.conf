## CMakeLists.txt
```
# SPDX-License-Identifier: Apache-2.0

cmake_minimum_required(VERSION 3.20.0)

find_package(Zephyr REQUIRED HINTS $ENV{ZEPHYR_BASE})
project(NONE)

target_sources(app PRIVATE
    src/main.c
    src/gss.c
	src/gps.c
	src/hum.c
)
```

## prj.conf
```kconfig
# Logger module
CONFIG_LOG=y
CONFIG_LOG_OVERRIDE_LEVEL=4


# Button and LED library   
CONFIG_DK_LIBRARY=y

# Bluetooth LE
CONFIG_BT=y
CONFIG_BT_PERIPHERAL=y
CONFIG_BT_DEVICE_NAME="MOB_TEST1"


# LTE and GPS control
#   CONFIG_LTE_LINK_CONTROL=y
#   CONFIG_LTE_NETWORK_MODE_LTE_M_GPS=y
#   CONFIG_DEBUG_THREAD_INFO=y
#   CONFIG_DEBUG_OPTIMIZATIONS=y

# Enable printing floating-point numbers
CONFIG_NEWLIB_LIBC=y
CONFIG_NEWLIB_LIBC_FLOAT_PRINTF=y
CONFIG_FPU=y

# DIS (Device Information Service) info
CONFIG_BT_DIS=y
CONFIG_BT_DIS_SETTINGS=y
CONFIG_BT_DIS_STR_MAX=21
CONFIG_BT_DIS_MODEL="MOB Unit 1"
CONFIG_BT_DIS_MANUF="Gol-IoT"
CONFIG_BT_DIS_SERIAL_NUMBER=y
CONFIG_BT_DIS_SERIAL_NUMBER_STR="ELZEN-0001"
CONFIG_BT_DIS_SW_REV=y
CONFIG_BT_DIS_SW_REV_STR="0.1.0"
CONFIG_BT_DIS_FW_REV=n
# CONFIG_BT_DIS_FW_REV_STR="Zephyr Firmware"
CONFIG_BT_DIS_HW_REV=n
# CONFIG_BT_DIS_HW_REV_STR="Zephyr Hardware"
CONFIG_BT_DIS_PNP=n
```

## src/main.c
```c
/*
 * Copyright (c) 2023 Nordic Semiconductor ASA
 *
 * SPDX-License-Identifier: LicenseRef-Nordic-5-Clause
 */


#include <zephyr/kernel.h>
#include <zephyr/logging/log.h>
#include <dk_buttons_and_leds.h>

#include "gss.h"
#include "gps.h"
#include "hum.h"
#include "ble.h"

LOG_MODULE_REGISTER(main_c, LOG_LEVEL_DBG);

#define RUN_LED_BLINK_INTERVAL 1000
/* LED to control */
#define USER_LED DK_LED3
/* Button to monitor */
#define USER_BUTTON DK_BTN1_MSK

static bool app_button_state;

static void app_led_cb(bool led_state)
{
	printk("LED state changed to %d\n", led_state);
	dk_set_led(USER_LED, led_state);
}

struct bt_conn_cb connection_callbacks = {
	.connected = on_connected,
	.disconnected = on_disconnected,
};

static struct gss_cb_s app_callbacks = {
	.gps_cb		= NULL,
	.mob_cb 	= NULL,
	.button_cb	= NULL,
	.led_cb		= app_led_cb,
};

static void button_changed(uint32_t button_state, uint32_t has_changed)
{
	if (has_changed & USER_BUTTON) {
		uint32_t user_button_state = button_state & USER_BUTTON;
		app_button_state = user_button_state ? true : false;
	}
}

static int init_button(void)
{
	int err;

	err = dk_buttons_init(button_changed);
	if (err) {
		printk("Cannot init buttons (err: %d)\n", err);
	}

	return err;
}

void main(void)
{
	LOG_DBG("Starting application (debug level)\n");
	LOG_INF("Starting application (info level)\n");
	LOG_WRN("Starting application (warning level)\n");
	LOG_ERR("Starting application (error level)\n");
	LOG_DBG("Starting application (debug level)\n");

	int blink_status = 0;
	int err;

	LOG_INF("Starting MOB unit application \n");

	err = dk_leds_init();
	if (err) {
		LOG_ERR("LEDs init failed (err %d)\n", err);
		return;
	}

	err = init_button();
	if (err) {
		LOG_ERR("Button init failed (err %d)\n", err);
		return;
	}

	err = gss_init(&app_callbacks);
	if (err)
	{
		LOG_ERR("Failed to init GSS (err:%d)\n", err);
		return;
	}
	
	ble_init(&connection_callbacks);

	for (;;) {
		dk_set_led(RUN_STATUS_LED, (++blink_status) % 2);
		k_sleep(K_MSEC(RUN_LED_BLINK_INTERVAL));
	}
}
```

## src/ble.c
```c
#include <zephyr/logging/log.h>
#include <zephyr/types.h>
#include <stddef.h>
#include <string.h>
#include <errno.h>

#include <zephyr/bluetooth/gatt.h>
#include <zephyr/bluetooth/conn.h>

#include "ble.h"
#include "gss.h"

LOG_MODULE_REGISTER(conn);

/* ADVERTISING PARAMETERS */
/* Connectable advertising and use identity address */
static struct bt_le_adv_param *adv_param = BT_LE_ADV_PARAM((BT_LE_ADV_OPT_CONNECTABLE | BT_LE_ADV_OPT_USE_IDENTITY),
														   800,	  /*Min Advertising Interval 500ms (800*0.625ms) */
														   2400,  /*Max Advertising Interval 1500ms (2400*0.625ms)*/
														   NULL); /* Set to NULL for undirected advertising*/

static const struct bt_data ad[] = {
	BT_DATA_BYTES(BT_DATA_FLAGS, (BT_LE_AD_GENERAL | BT_LE_AD_NO_BREDR)),
	BT_DATA(BT_DATA_MANUFACTURER_DATA, CONFIG_BT_DIS_MODEL, sizeof(CONFIG_BT_DIS_MODEL) - 1),
	BT_DATA(BT_DATA_MANUFACTURER_DATA, CONFIG_BT_DIS_SERIAL_NUMBER_STR, sizeof(CONFIG_BT_DIS_SERIAL_NUMBER_STR) - 1),
};

static const struct bt_data sd[] = {
	BT_DATA_BYTES(BT_DATA_UUID128_ALL, BT_UUID_GSS_VAL),
	BT_DATA(BT_DATA_NAME_COMPLETE, CONFIG_BT_DEVICE_NAME, sizeof(CONFIG_BT_DEVICE_NAME) - 1),
};

int ble_init(struct bt_conn_cb *connection_cb)
{
	int err;
	err = bt_enable(NULL);
	if (err)
	{
		LOG_ERR("Bluetooth init failed (err %d)\n", err);
		return err;
	}
	bt_conn_cb_register(connection_cb);

	LOG_INF("Bluetooth initialized\n");
	err = bt_le_adv_start(adv_param, ad, ARRAY_SIZE(ad),
						  sd, ARRAY_SIZE(sd));
	if (err)
	{
		LOG_ERR("Advertising failed to start (err %d)\n", err);
		return;
	}

	LOG_INF("Advertising successfully started\n");
}

/* BLUETOOTH CONNECTION CALLBACKS */

void on_connected(struct bt_conn *conn, uint8_t err)
{
	if (err)
	{
		printk("Connection failed (err %u)\n", err);
		return;
	}

	printk("Connected\n");

	dk_set_led_on(CON_STATUS_LED);
}

void on_disconnected(struct bt_conn *conn, uint8_t reason)
{
	printk("Disconnected (reason %u)\n", reason);

	dk_set_led_off(CON_STATUS_LED);
}
```

## src/ble.h
```c
#ifndef ble_H
#define ble_H

// Includes
#include <zephyr/bluetooth/conn.h>

// Defines
#define DEVICE_NAME CONFIG_BT_DEVICE_NAME
#define DEVICE_NAME_LEN (sizeof(DEVICE_NAME) - 1)
#define MODEL CONFIG_BT_DIS_MODEL
#define MODEL_LEN (sizeof(MODEL) - 1)

// Prototypes
int ble_init(struct bt_conn_cb *bt_connection_cb);

#endif  // ble_H
```

## src/gps.c
```c
#include "gps.h"

// Dummy function that returns
dummy_gps_data_t getGPSData(void) {
	dummy_gps_data_t gps_data;
	return gps_data;
}
```

## src/gss.c
```c
/*
 * Copyright (c) 2018 Nordic Semiconductor ASA
 *
 * SPDX-License-Identifier: LicenseRef-Nordic-5-Clause
 */

/** @file
 *  @brief LED Button Service (LBS) sample
 */

#include <zephyr/types.h>
#include <stddef.h>
#include <string.h>
#include <errno.h>
#include <zephyr/sys/printk.h>
#include <zephyr/sys/byteorder.h>
#include <zephyr/kernel.h>

#include <zephyr/bluetooth/bluetooth.h>
#include <zephyr/bluetooth/hci.h>
#include <zephyr/bluetooth/conn.h>
#include <zephyr/bluetooth/uuid.h>
#include <zephyr/bluetooth/gatt.h>

#include "gss.h"

#include <zephyr/logging/log.h>

LOG_MODULE_REGISTER(gss, LOG_LEVEL_DBG);

static struct gss_cb_s gss_cb;

/* GPS Sensor Service Declaration */
/* Creates and adds the GSS service to the Bluetooth LE stack */
BT_GATT_SERVICE_DEFINE(gss_svc,
					   BT_GATT_PRIMARY_SERVICE(BT_UUID_GSS),
					   /* STEP 3 - Create and add the Button characteristic */
					   BT_GATT_CHARACTERISTIC(BT_UUID_GSS_GPS,
											  BT_GATT_CHRC_READ,
											  BT_GATT_PERM_READ, NULL, NULL,
											  NULL),
					   /* STEP 4 - Create and add the LED characteristic. */
					   BT_GATT_CHARACTERISTIC(BT_UUID_GSS_MOB,
											  BT_GATT_CHRC_WRITE,
											  BT_GATT_PERM_WRITE,
											  NULL, write_led, NULL),

);

/* CALLBACKS */

/* A function to register application callbacks */
int gss_init(struct gss_cb_s *callbacks)
{
	if (callbacks)
	{
		gss_cb.gps_cb = callbacks->gps_cb;
		gss_cb.mob_cb = callbacks->mob_cb;
		gss_cb.button_cb = callbacks->button_cb;
		gss_cb.led_cb = callbacks->led_cb;
	}

	return 0;
}

/* Write callback */
static ssize_t write_led(struct bt_conn *conn,
						 const struct bt_gatt_attr *attr,
						 const void *buf,
						 uint16_t len, uint16_t offset, uint8_t flags)
{
	LOG_DBG("Attribute write, handle: %u, conn: %p", attr->handle,
			(void *)conn);

	if (len != 1U)
	{
		LOG_DBG("Write led: Incorrect data length");
		return BT_GATT_ERR(BT_ATT_ERR_INVALID_ATTRIBUTE_LEN);
	}

	if (offset != 0)
	{
		LOG_DBG("Write led: Incorrect data offset");
		return BT_GATT_ERR(BT_ATT_ERR_INVALID_OFFSET);
	}

	LOG_DBG("Checking if led_cb is set");
	if (gss_cb.led_cb)
	{
		// Read the received value
		uint8_t val = *((uint8_t *)buf);
		LOG_DBG("Received value: %d", val);

		if (val == 0x00 || val == 0x01)
		{
			LOG_DBG("Writing value %d to LED characteristic", val);
			// Call the application callback function to update the LED state
			bool led_state = val ? true : false;
			gss_cb.led_cb(led_state);
			LOG_DBG("LED state updated");
		}
		else
		{
			LOG_DBG("Write led: Incorrect value");
			return BT_GATT_ERR(BT_ATT_ERR_VALUE_NOT_ALLOWED);
		}
	}

	return len;
}
```

## src/gss.h
```c
#ifndef GSS_H_
#define GSS_H_

#ifdef __cplusplus
extern "C"
{
#endif

#include <zephyr/types.h>
#include <stddef.h>
#include <string.h>
#include <errno.h>
#include <zephyr/sys/printk.h>
#include <zephyr/sys/byteorder.h>
#include <zephyr/kernel.h>

#include <dk_buttons_and_leds.h>

#include <zephyr/bluetooth/bluetooth.h>
#include <zephyr/bluetooth/hci.h>
#include <zephyr/bluetooth/conn.h>
#include <zephyr/bluetooth/uuid.h>
#include <zephyr/bluetooth/gatt.h>

#define RUN_STATUS_LED          DK_LED1
#define CON_STATUS_LED          DK_LED2
/* LED to control */
#define USER_LED DK_LED3
/* Button to monitor */
#define USER_BUTTON DK_BTN1_MSK

/* CUSTOM SERVICE UUIDs */

/** @brief GSS Service UUID. */
#define BT_UUID_GSS_VAL \
	BT_UUID_128_ENCODE(0x6dea7370, 0x0bdf, 0x43db, 0x8ea8, 0x1c3a6a7e5909)

/** @brief GPS Characteristic UUID. */
#define BT_UUID_GSS_GPS_VAL \
	BT_UUID_128_ENCODE(0x6dea7371, 0x0bdf, 0x43db, 0x8ea8, 0x1c3a6a7e5909)

/** @brief Humidity Sensor Characteristic UUID. */
#define BT_UUID_GSS_MOB_VAL \
	BT_UUID_128_ENCODE(0x6dea7372, 0x0bdf, 0x43db, 0x8ea8, 0x1c3a6a7e5909)

#define BT_UUID_GSS           BT_UUID_DECLARE_128(BT_UUID_GSS_VAL)
#define BT_UUID_GSS_GPS       BT_UUID_DECLARE_128(BT_UUID_GSS_GPS_VAL)
#define BT_UUID_GSS_MOB       BT_UUID_DECLARE_128(BT_UUID_GSS_MOB_VAL)


/* CALLBACK STRUCTURE */

/** @brief Callback type for reading the GPS data */
typedef int (*gps_cb_t)(void);

/** @brief Callback type for humidity sensor reading */
typedef int (*mob_cb_t)(void);

/** @brief Callback type for when an LED state change is received. */
typedef void (*led_cb_t)(const bool led_state);

/** @brief Callback type for when the button state is pulled. */
typedef bool (*button_cb_t)(void);

/** @brief Callback struct used by the GSS Service. */
struct gss_cb_s
{
	/** GPS reading callback. */
	gps_cb_t gps_cb;
	/** Humidity change callback. */
	mob_cb_t mob_cb;
	/** LED state change callback. */
	led_cb_t led_cb;
	/** Button read callback. */
	button_cb_t button_cb;
};


/* FUNCTION PROTOTYPES */

/* Callbacks */
/** @brief Initialize the GSS Service.
 * This function registers application callback functions with the GSS Service
 * @param[in] callbacks Struct containing pointers to callback functions
 *			used by the service. This pointer can be NULL
 *			if no callback functions are defined.
 * @retval 0 If the operation was successful.
 *           Otherwise, a (negative) error code is returned.
 */
int gss_init(struct gss_cb_s *callbacks);
static ssize_t write_led(struct bt_conn *conn,
						 const struct bt_gatt_attr *attr,
						 const void *buf,
						 uint16_t len, uint16_t offset, uint8_t flags);



#ifdef __cplusplus
}
#endif

#endif /* GSS_H_ */
```
